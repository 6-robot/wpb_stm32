/********************************************Copyright******************************************************
**                                                                                                      
**
**-------------------------------------------文件信息-------------------------------------------------------
** 文件名称:			Wp_GPIO.c
** 最后修订日期:  		2012-10-10
** 最后版本:			1.0
** 描述:				GPIO初始化文件;
**
**-----------------------------------------------------------------------------------------------------------
** 创建人:				吴康
** 创建日期:			2012-02-09
** 版本:				1.0
** 描述:				GPIO初始化文件;
**
**-----------------------------------------------------------------------------------------------------------
** 修订人:
** 修订日期:
** 版本:
** 描述:
**
**-----------------------------------------------------------------------------------------------------------
** 修订人:
** 修订日期:
** 版本:
** 描述:
**
*************************************************************************************************************/
#include "Wp_GPIO.h"


/*************************************************************************************************************
** 函数名称:			Wp_FlowLights
**
** 函数描述:			流水灯函数;
** 						
**					    
** 输入变量:			u8 dismode;
** 返回值:				void;
**
** 使用宏或常量:		None;
** 使用全局变量:		None;
**
** 调用函数:			None;
**
** 创建人:				
** 创建日期:			2011-11-1
**-------------------------------------------------------------------------------------------------------------
** 修订人:
** 修订日期:
**-------------------------------------------------------------------------------------------------------------
***************************************************************************************************************/
void Wp_FlowLights(u8 dismode)
{
    static u8 i = 0;
    static u8 j = 0;
    
    switch (dismode)
    {
        case 0:
            GPIOB->BRR = GPIO_Pin_6;
            GPIOB->BRR = GPIO_Pin_7;
            GPIOB->BRR = GPIO_Pin_8;
            GPIOB->BRR = GPIO_Pin_9;
            GPIOE->BRR = GPIO_Pin_0;
            GPIOE->BRR = GPIO_Pin_1;
            GPIOE->BRR = GPIO_Pin_2;
            GPIOE->BRR = GPIO_Pin_3;
            
            break;
        case 1:
            j = 0;
            
            if (i < 4)
            {
                GPIOB->ODR ^= GPIO_Pin_6 << i;
            }
            else
            {
                GPIOE->ODR ^= GPIO_Pin_0 << (i - 4);
            }
            
            i++;
            if (i >= 8)
                i = 0;
            
            break;
        case 2:
            i = 0;
        
            if (j < 4)
            {
                GPIOB->BSRR = GPIO_Pin_6 << j;
            }
            else if (j >= 4 && j < 8)
            {
                GPIOE->BSRR = GPIO_Pin_0 << (j - 4);
            }
            
            j++;
            if (j >= 10)
            {
                j = 0;
                
                GPIOB->BRR = GPIO_Pin_6;
                GPIOB->BRR = GPIO_Pin_7;
                GPIOB->BRR = GPIO_Pin_8;
                GPIOB->BRR = GPIO_Pin_9;
                GPIOE->BRR = GPIO_Pin_0;
                GPIOE->BRR = GPIO_Pin_1;
                GPIOE->BRR = GPIO_Pin_2;
                GPIOE->BRR = GPIO_Pin_3;
            }
            
            break;
        default:
            break;
    }
}


/*************************************************************************************************************
** 函数名称:			Wp_GetInputValue
**
** 函数描述:			获取所有INPUT端口的值;
** 						返回u8，低四位为输入端口4~1的值;
**					    
** 输入变量:			void;
** 返回值:				u8;
**
** 使用宏或常量:		None;
** 使用全局变量:		None;
**
** 调用函数:			None;
**
** 创建人:				
** 创建日期:			2011-11-1
**-------------------------------------------------------------------------------------------------------------
** 修订人:
** 修订日期:
**-------------------------------------------------------------------------------------------------------------
***************************************************************************************************************/
u8 Wp_GetInputValue(void)
{
    u8 temp = 0;
    
    temp = GPIO_ReadInputDataBit(GPIOD, GPIO_Pin_0);
    temp |= GPIO_ReadInputDataBit(GPIOD, GPIO_Pin_1) << 1;
    temp |= GPIO_ReadInputDataBit(GPIOD, GPIO_Pin_2) << 2;
    temp |= GPIO_ReadInputDataBit(GPIOD, GPIO_Pin_3) << 3;
    
    temp = temp & 0x0f;
    
    return temp;
}


/*************************************************************************************************************
** 函数名称:			Wp_GetPortInputValue
**
** 函数描述:			获取任意一个INPUT端口的值;
** 						port选择范围1~4;
**					    返回值高电平：1，低电平：0;
** 输入变量:			u8 port;
** 返回值:				u8;
**
** 使用宏或常量:		None;
** 使用全局变量:		None;
**
** 调用函数:			None;
**
** 创建人:				
** 创建日期:			2011-11-1
**-------------------------------------------------------------------------------------------------------------
** 修订人:
** 修订日期:
**-------------------------------------------------------------------------------------------------------------
***************************************************************************************************************/
u8 Wp_GetPortInputValue(u8 port)
{
    u8 temp = 0;
    
    temp = GPIO_ReadInputDataBit(GPIOD, (GPIO_Pin_0 << (port - 1)));
    
    return temp;
}

u8 Port_GetInputValue(u8 Port)
{
	return Wp_GetPortInputValue(Port);
}


/*************************************************************************************************************
** 函数名称:			Wp_GetOutputValue
**
** 函数描述:			获取所有OUTPUT端口的值;
** 						返回u8，高四位代表：8~5，低四位代表：4~1;
**					    
** 输入变量:			void;
** 返回值:				u8;
**
** 使用宏或常量:		None;
** 使用全局变量:		None;
**
** 调用函数:			None;
**
** 创建人:				
** 创建日期:			2011-11-1
**-------------------------------------------------------------------------------------------------------------
** 修订人:
** 修订日期:
**-------------------------------------------------------------------------------------------------------------
***************************************************************************************************************/
u8 Wp_GetOutputValue(void)
{
    u8 temp = 0;
    
    temp = GPIO_ReadOutputDataBit(GPIOB, GPIO_Pin_6);
    temp |= GPIO_ReadOutputDataBit(GPIOB, GPIO_Pin_7) << 1;
    temp |= GPIO_ReadOutputDataBit(GPIOB, GPIO_Pin_8) << 2;
    temp |= GPIO_ReadOutputDataBit(GPIOB, GPIO_Pin_9) << 3;
    
    temp |= GPIO_ReadOutputDataBit(GPIOE, GPIO_Pin_0) << 4;
    temp |= GPIO_ReadOutputDataBit(GPIOE, GPIO_Pin_1) << 5;
    temp |= GPIO_ReadOutputDataBit(GPIOE, GPIO_Pin_2) << 6;
    temp |= GPIO_ReadOutputDataBit(GPIOE, GPIO_Pin_3) << 7;
    
    return temp;
}


/*************************************************************************************************************
** 函数名称:			Wp_GetPortOutputValue
**
** 函数描述:			获取任意OUTPUT端口的值;
**                      port选择范围1~8;
** 						返回值高电平：1，低电平：0;
** 输入变量:			u8 port;
** 返回值:				u8;
**
** 使用宏或常量:		None;
** 使用全局变量:		None;
**
** 调用函数:			None;
**
** 创建人:				
** 创建日期:			2011-11-1
**-------------------------------------------------------------------------------------------------------------
** 修订人:
** 修订日期:
**-------------------------------------------------------------------------------------------------------------
***************************************************************************************************************/
u8 Wp_GetPortOutputValue(u8 port)
{
    u8 temp = 0;
    
    if (port <= 4)
    {
        temp = GPIO_ReadOutputDataBit(GPIOB, (GPIO_Pin_6 << (port - 1)));
    }
    else
    {
        temp |= GPIO_ReadOutputDataBit(GPIOE, (GPIO_Pin_0 << (port - 5)));
    }
    
    return temp;
}

u8 Port_GetOutputValue(u8 Port)
{
	return Wp_GetPortOutputValue(Port);
}
/*************************************************************************************************************
** 函数名称:			Wp_SetOutputValue
**
** 函数描述:			设置所有OUTPUT端口的值;
** 						value：1，设置高电平，value：0，设置低电平;
**					    
** 输入变量:			u8 value;
** 返回值:				void;
**
** 使用宏或常量:		None;
** 使用全局变量:		None;
**
** 调用函数:			None;
**
** 创建人:				
** 创建日期:			2011-11-1
**-------------------------------------------------------------------------------------------------------------
** 修订人:
** 修订日期:
**-------------------------------------------------------------------------------------------------------------
***************************************************************************************************************/
void Wp_SetOutputValue(u8 value)
{
    if (value)
    {
        PWM_1_H;
        PWM_2_H;
        PWM_3_H;
        PWM_4_H;
        OUTPUT_1_H;
        OUTPUT_2_H;
        OUTPUT_3_H;
        OUTPUT_4_H;
    }
    else
    {
        PWM_1_L;
        PWM_2_L;
        PWM_3_L;
        PWM_4_L;
        OUTPUT_1_L;
        OUTPUT_2_L;
        OUTPUT_3_L;
        OUTPUT_4_L;
    }
}


/*************************************************************************************************************
** 函数名称:			Wp_SetPortOutputValue
**
** 函数描述:			设置任意一个OUTPUT端口的值;
** 						port选择范围1~8，value：1，输出高电平，0：输出低电平;
**					    
** 输入变量:			u8 port, u8 value;
** 返回值:				void;
**
** 使用宏或常量:		None;
** 使用全局变量:		None;
**
** 调用函数:			None;
**
** 创建人:				
** 创建日期:			2011-11-1
**-------------------------------------------------------------------------------------------------------------
** 修订人:
** 修订日期:
**-------------------------------------------------------------------------------------------------------------
***************************************************************************************************************/
void Wp_SetPortOutputValue(u8 port, u8 value)
{
    if (port <= 4)
    {
        if (value)
            GPIO_SetBits(GPIOB, (GPIO_Pin_6 << (port - 1)));
        else
            GPIO_ResetBits(GPIOB, (GPIO_Pin_6 << (port - 1)));
    }
    else
    {
        if (value)
            GPIO_SetBits(GPIOE, (GPIO_Pin_0 << (port - 5)));
        else
            GPIO_ResetBits(GPIOE, (GPIO_Pin_0 << (port - 5)));   
    }
}

void Port_SetOutputValue(u8 Port, u8 Value)
{
	Wp_SetPortOutputValue(Port, Value);
}
/*************************************************************************************************************
** 函数名称:			Wp_GpioConfigure
**
** 函数描述:			GPIO配置初始化函数;
** 						
**					    
** 输入变量:			void;
** 返回值:				void;
**
** 使用宏或常量:		None;
** 使用全局变量:		None;
**
** 调用函数:			None;
**
** 创建人:				
** 创建日期:			2011-11-1
**-------------------------------------------------------------------------------------------------------------
** 修订人:
** 修订日期:
**-------------------------------------------------------------------------------------------------------------
***************************************************************************************************************/
void Wp_GpioConfigure(void)
{   
	GPIO_InitTypeDef GPIO_InitStructure;
    
	RCC_APB2PeriphClockCmd(RCC_APB2Periph_GPIOB | RCC_APB2Periph_GPIOC | 
                           RCC_APB2Periph_GPIOD | RCC_APB2Periph_GPIOE, ENABLE);
	
	LED1_OFF;
	LED2_OFF;
    
	/*	PC11, PC12作为LED指示灯				        */
	GPIO_InitStructure.GPIO_Pin = GPIO_Pin_11 | GPIO_Pin_12;
	GPIO_InitStructure.GPIO_Mode = GPIO_Mode_Out_PP;		// 推挽输出
	GPIO_InitStructure.GPIO_Speed = GPIO_Speed_50MHz;		// 50M时钟速度
	GPIO_Init(GPIOC, &GPIO_InitStructure);					// GPIOC初始化
	
    /*	PD0, PD1, PD3, PD3作为控制器GPIO输入口      */
	GPIO_InitStructure.GPIO_Pin = GPIO_Pin_0 | GPIO_Pin_1 | GPIO_Pin_2 | GPIO_Pin_3;
	GPIO_InitStructure.GPIO_Mode = GPIO_Mode_IPU;		    // 上拉输入
	GPIO_Init(GPIOD, &GPIO_InitStructure);					// GPIOD初始化
    
    /*	PB6, PB7, PB8, PB9作为控制器输出口          */
	GPIO_InitStructure.GPIO_Pin = GPIO_Pin_6 | GPIO_Pin_7 | GPIO_Pin_8 | GPIO_Pin_9;
	GPIO_InitStructure.GPIO_Mode = GPIO_Mode_Out_PP;		// 推挽输出
	GPIO_InitStructure.GPIO_Speed = GPIO_Speed_50MHz;		// 50M时钟速度
	GPIO_Init(GPIOB, &GPIO_InitStructure);					// GPIOD初始化
    
	/*	PE0, PE1, PE3, PE3作为控制器输出口          */
	GPIO_InitStructure.GPIO_Pin = GPIO_Pin_0 | GPIO_Pin_1 | GPIO_Pin_2 | GPIO_Pin_3;
	GPIO_InitStructure.GPIO_Mode = GPIO_Mode_Out_PP;		// 推挽输出
	GPIO_InitStructure.GPIO_Speed = GPIO_Speed_50MHz;		// 50M时钟速度
	GPIO_Init(GPIOE, &GPIO_InitStructure);					// GPIOD初始化
}


/********************************************************************************************************
**                            End Of File
********************************************************************************************************/
