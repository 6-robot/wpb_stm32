/********************************************Copyright******************************************************
**                                                                                                      
**
**-------------------------------------------文件信息-------------------------------------------------------
** 文件名称:			Wp_OLED.c
** 最后修订日期:  		2012-10-10
** 最后版本:			1.0
** 描述:				OLED驱动函数;
**
**-----------------------------------------------------------------------------------------------------------
** 创建人:				吴康
** 创建日期:			2012-02-09
** 版本:				1.0
** 描述:				OLED驱动函数;
**
**-----------------------------------------------------------------------------------------------------------
** 修订人:
** 修订日期:
** 版本:
** 描述:
**
**-----------------------------------------------------------------------------------------------------------
** 修订人:
** 修订日期:
** 版本:
** 描述:
**
*************************************************************************************************************/
#include "Wp_OLED.h"


// 16*16的点阵字体，取模方式：共阴，列行式，逆向输出，启智模块化机器人
const unsigned char Name16x16[] = 
{
    0x00, 0x00, 0x00, 0xFC, 0x44, 0x44, 0x44, 0x45, 0x46, 0x44, 0x44, 0x44, 0x44, 0x7C, 0x00, 0x00,
    0x40, 0x20, 0x18, 0x07, 0x00, 0xFC, 0x44, 0x44, 0x44, 0x44, 0x44, 0x44, 0x44, 0xFC, 0x00, 0x00,     // 启

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    0x80, 0x40, 0x20, 0x10, 0x0C, 0x03, 0x00, 0x00, 0x00, 0x03, 0x0C, 0x10, 0x20, 0x40, 0x80, 0x00      // 人
};

// 16*16的点阵字体，取模方式：共阴，列行式，逆向输出，姿态信息
const unsigned char Atti16x16[] = 
{
    0x20, 0x21, 0xF2, 0x08, 0x04, 0x10, 0x88, 0x84, 0x47, 0x34, 0x44, 0x84, 0x94, 0x0C, 0x00, 0x00,     // 姿
    0x04, 0x84, 0x85, 0x94, 0x5D, 0x57, 0x24, 0x24, 0x24, 0x54, 0x4C, 0x44, 0x84, 0x05, 0x05, 0x00,

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    0x40, 0x30, 0x00, 0x03, 0x39, 0x41, 0x41, 0x45, 0x59, 0x41, 0x41, 0x73, 0x00, 0x08, 0x30, 0x00
};

// 6*8的点阵
const unsigned char F6x8[][6] =
{
    { 0x00, 0x00, 0x00, 0x00, 0x00, 0x00 },   // sp
    { 0x00, 0x00, 0x00, 0x2f, 0x00, 0x00 },   // !
    { 0x00, 0x00, 0x07, 0x00, 0x07, 0x00 },   // "
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    { 0x14, 0x14, 0x14, 0x14, 0x14, 0x14 }    // horiz lines
};

// 8*16的点阵
const unsigned char F8X16[]=
{
	0x00,0x00,0x00,0x00,0x00,0x00,0x00,0x00,0x00,0x00,0x00,0x00,0x00,0x00,0x00,0x00,    // 0
	0x00,0x00,0x00,0xF8,0x00,0x00,0x00,0x00,0x00,0x00,0x00,0x33,0x30,0x00,0x00,0x00,    //!1
	0x00,0x10,0x0C,0x06,0x10,0x0C,0x06,0x00,0x00,0x00,0x00,0x00,0x00,0x00,0x00,0x00,    //"2
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	0x00,0x06,0x01,0x01,0x02,0x02,0x04,0x04,0x00,0x00,0x00,0x00,0x00,0x00,0x00,0x00     //~94
};


/*************************************************************************************************************
** 函数名称:			OLED_DLY_ms
**
** 函数描述:			OLED使用延时函数;
** 						
**					    
** 输入变量:			unsigned int ms;
** 返回值:				void;
**
** 使用宏或常量:		None;
** 使用全局变量:		None;
**
** 调用函数:			None;
**
** 创建人:				
** 创建日期:			2011-11-1
**-------------------------------------------------------------------------------------------------------------
** 修订人:
** 修订日期:
**-------------------------------------------------------------------------------------------------------------
***************************************************************************************************************/
static void OLED_DLY_ms(unsigned int ms)
{                         
//	unsigned int a = 0;
    uint8_t a = 0;
      
	while (ms)
	{
		a = 100;                // 默认a = 1335，20161119修改为a = 100
		while(a--);
		ms--;
	}
    
	return;
}


/*************************************************************************************************************
** 函数名称:			OLED_WrDat
**
** 函数描述:			写IIC数据函数;
** 						
**					    
** 输入变量:			unsigned char data;
** 返回值:				void;
**
** 使用宏或常量:		None;
** 使用全局变量:		None;
**
** 调用函数:			None;
**
** 创建人:				
** 创建日期:			2011-11-1
**-------------------------------------------------------------------------------------------------------------
** 修订人:
** 修订日期:
**-------------------------------------------------------------------------------------------------------------
***************************************************************************************************************/
static void OLED_WrDat(unsigned char data)
{
	unsigned char i = 8;

	OLED_DC_OH;
	__NOP();
	OLED_D0_OL;
	__NOP();
    
	while (i--)
	{
		if (data & 0x80)
		{
            OLED_D1_OH;
        }
		else
		{
            OLED_D1_OL;
        }
        
		OLED_D0_OH;
		__NOP();		
		OLED_D0_OL;
        
		data <<= 1;    
	}
}


/*************************************************************************************************************
** 函数名称:			OLED_WrCmd
**
** 函数描述:			写IIC命令函数;
** 						
**					    
** 输入变量:			unsigned char cmd;
** 返回值:				void;
**
** 使用宏或常量:		None;
** 使用全局变量:		None;
**
** 调用函数:			None;
**
** 创建人:				
** 创建日期:			2011-11-1
**-------------------------------------------------------------------------------------------------------------
** 修订人:
** 修订日期:
**-------------------------------------------------------------------------------------------------------------
***************************************************************************************************************/
static void OLED_WrCmd(unsigned char cmd)
{
	unsigned char i = 8;
    
	OLED_DC_OL;
	OLED_D0_OL;
	__NOP();
    
	while (i--)
	{
		if (cmd & 0x80)
		{
            OLED_D1_OH;
        }
		else
		{
            OLED_D1_OL;
        }

		OLED_D0_OH;
		__NOP();
		OLED_D0_OL;
        
		cmd <<= 1;
	}
}


/*************************************************************************************************************
** 函数名称:			OLED_Set_Pos
**
** 函数描述:			设置起始坐标;
** 						
**					    
** 输入变量:			unsigned char x, unsigned char y;
** 返回值:				void;
**
** 使用宏或常量:		None;
** 使用全局变量:		None;
**
** 调用函数:			None;
**
** 创建人:				
** 创建日期:			2011-11-1
**-------------------------------------------------------------------------------------------------------------
** 修订人:
** 修订日期:
**-------------------------------------------------------------------------------------------------------------
***************************************************************************************************************/
static void OLED_Set_Pos(unsigned char x, unsigned char y)
{
    OLED_WrCmd(0xb0 + y);
    OLED_WrCmd(((x & 0xf0) >> 4) | 0x10);
    OLED_WrCmd((x & 0x0f) | 0x01);
}


/*************************************************************************************************************
** 函数名称:			Wp_FillOled
**
** 函数描述:			满屏函数;
** 						
**					    
** 输入变量:			void;
** 返回值:				void;
**
** 使用宏或常量:		None;
** 使用全局变量:		None;
**
** 调用函数:			None;
**
** 创建人:				
** 创建日期:			2011-11-1
**-------------------------------------------------------------------------------------------------------------
** 修订人:
** 修订日期:
**-------------------------------------------------------------------------------------------------------------
***************************************************************************************************************/
void Wp_FillOled(void)     
{
	unsigned char x = 0, y = 0;
	
	for(y = 0; y < 8; y++)          // 页指针
	{
		OLED_WrCmd(0xb0 + y);
	//	OLED_WrCmd(0x01);
        OLED_WrCmd(0x00);
		OLED_WrCmd(0x10);
        
		for(x = 0; x < X_WIDTH; x++)
        {
            OLED_WrDat(0xff);       // 写数据比如写0x00为清屏 0xff为满屏
        }
	}
}


/*************************************************************************************************************
** 函数名称:			Wp_ClearOled
**
** 函数描述:			清屏函数;
** 						
**					    
** 输入变量:			void;
** 返回值:				void;
**
** 使用宏或常量:		None;
** 使用全局变量:		None;
**
** 调用函数:			None;
**
** 创建人:				
** 创建日期:			2011-11-1
**-------------------------------------------------------------------------------------------------------------
** 修订人:
** 修订日期:
**-------------------------------------------------------------------------------------------------------------
***************************************************************************************************************/
void Wp_ClearOled(void)
{
	unsigned char x = 0, y = 0;	
    
	for (y = 0; y < 8; y++)
	{
		OLED_WrCmd(0xb0 + y);       // 列指针
	//	OLED_WrCmd(0x01);           // Default set
        OLED_WrCmd(0x00);
		OLED_WrCmd(0x10); 
        
		for(x = 0; x < X_WIDTH; x++)
        {
            OLED_WrDat(0x00);       // 写数据比如写0x00为清屏 0xff为满屏
        }
	}
    
    oled_x = 0;
    oled_y = 0;
}

void OLED_Clear(void)
{
	Wp_ClearOled();
}


/*************************************************************************************************************
** 函数名称:			Wp_OledInit
**
** 函数描述:			OLED初始化;
** 						
**					    
** 输入变量:			void;
** 返回值:				void;
**
** 使用宏或常量:		None;
** 使用全局变量:		None;
**
** 调用函数:			None;
**
** 创建人:				
** 创建日期:			2011-11-1
**-------------------------------------------------------------------------------------------------------------
** 修订人:
** 修订日期:
**-------------------------------------------------------------------------------------------------------------
***************************************************************************************************************/
void Wp_OledInit(void)        
{
	GPIO_InitTypeDef OLED_GPIO_InitStructure;

	RCC_APB2PeriphClockCmd(RCC_APB2Periph_GPIOD, ENABLE);

	OLED_GPIO_InitStructure.GPIO_Pin = OLED_SCL | OLED_SDA | OLED_RST | OLED_DC;
	OLED_GPIO_InitStructure.GPIO_Speed = GPIO_Speed_50MHz;
	OLED_GPIO_InitStructure.GPIO_Mode = GPIO_Mode_Out_PP;
	GPIO_Init(GPIOD, &OLED_GPIO_InitStructure);
	
	OLED_D0_OH;
	
	OLED_RST_OL;                    // 从上电到下面开始初始化要有足够的时间，即等待RC复位完毕
	OLED_DLY_ms(50);
	OLED_RST_OH;
	
    OLED_WrCmd(0xAE | 0x00);	 	// Display Off (0x00)
    OLED_WrCmd(0xD5);
    OLED_WrCmd(0x80);		     	// Set Clock as 100 Frames/Sec
    OLED_WrCmd(0xA8);
    OLED_WrCmd(0x3F);	         	// 1/64 Duty (0x0F~0x3F)
    OLED_WrCmd(0xD3);
    OLED_WrCmd(0x00);		     	// Shift Mapping RAM Counter (0x00~0x3F)
    OLED_WrCmd(0x40 | 0x00);     	// Set Mapping RAM Display Start Line (0x00~0x3F)
    OLED_WrCmd(0x8D);
    OLED_WrCmd(0x10 | 0x04);	 	// Enable Embedded DC/DC Converter (0x00/0x04)
    OLED_WrCmd(0x20);
    OLED_WrCmd(0x02);		     	// Set Page Addressing Mode (0x00/0x01/0x02)
    OLED_WrCmd(0xA0 | 0x01);     	// Set SEG/Column Mapping
    OLED_WrCmd(0xC0 | 0x08);     	// Set COM/x Scan Direction
    OLED_WrCmd(0xDA);
    OLED_WrCmd(0x02 | 0x10);     	// Set Sequential Configuration (0x00/0x10)
    OLED_WrCmd(0x81);
    OLED_WrCmd(0xCF);	         	// Set SEG Output Current
    OLED_WrCmd(0xD9);
    OLED_WrCmd(0xF1);            	// Set Pre-Charge as 15 Clocks & Discharge as 1 Clock
    OLED_WrCmd(0xDB);
    OLED_WrCmd(0x40);	         	// Set VCOM Deselect Level
    OLED_WrCmd(0xA4 | 0x00);	 	// Disable Entire Display On (0x00/0x01)
    OLED_WrCmd(0xA6 | 0x00);	 	// Disable Inverse Display On (0x00/0x01)
    OLED_WrCmd(0xAE | 0x01);     	// Display On (0x01)
    
	Wp_ClearOled();  			 	// 初始清屏
	OLED_Set_Pos(0, 0);  	        // 设置起始坐标
}


/*************************************************************************************************************
** 函数名称:			OLED_P6x8Char
**
** 函数描述:			写入一组标准ASCII字符串，小字符;
** 						显示的位置(x, y)，x为行范围0~120，y为页范围0~7，要显示的字符;
**					    
** 输入变量:			u8 x, u8 y, char ch;
** 返回值:				void;
**
** 使用宏或常量:		None;
** 使用全局变量:		None;
**
** 调用函数:			None;
**
** 创建人:				
** 创建日期:			2011-11-1
**-------------------------------------------------------------------------------------------------------------
** 修订人:
** 修订日期:
**-------------------------------------------------------------------------------------------------------------
***************************************************************************************************************/
void OLED_P6x8Char(u8 x, u8 y, char ch)
{
	u8 c = 0, i = 0;
    
    if (x > 122 && y > 7)
        return;
    
    x = x*6;
    
    OLED_Set_Pos(x, y);
    
    if (ch >= 32 && ch <= 125)
	{
		c = ch - 32;
        
		for (i = 0; i < 6; i++)
        {
            OLED_WrDat(F6x8[c][i]);
        }
	}
}


/*************************************************************************************************************
** 函数名称:			OLED_P6x8Str
**
** 函数描述:			写入一组标准ASCII字符串，小字符串;
** 						显示的位置(x, y)，x为行范围0~120，y为页范围0~7，要显示的字符串;
**					    
** 输入变量:			u8 x, u8 y, char ch[];
** 返回值:				void;
**
** 使用宏或常量:		None;
** 使用全局变量:		None;
**
** 调用函数:			None;
**
** 创建人:				
** 创建日期:			2011-11-1
**-------------------------------------------------------------------------------------------------------------
** 修订人:
** 修订日期:
**-------------------------------------------------------------------------------------------------------------
***************************************************************************************************************/
void OLED_P6x8Str(u8 x, u8 y, char ch[])		
{
	u8 c = 0, i = 0, j = 0;
    
    if (x > 122 && y > 7)
        return;
    
    x = x*6;
    
//	OLED_Set_Pos(x*6, y);                   // 原代码设置起始坐标代码
    OLED_Set_Pos(x, y);
    
	while (ch[j] != '\0')
	{
		c = ch[j] - 32;
		if (x > 122)                        // 原代码 if (x > 126)
        {
            x = 0;
            y++;
            
            if (y > 7)
                return;
        }
        
		for (i = 0; i < 6; i++)
        {
            OLED_WrDat(F6x8[c][i]);
        }
        
		x += 6;
		j++;
	}
}


/*************************************************************************************************************
** 函数名称:			OLED_P8x16Char
**
** 函数描述:			写入一个标准ASCII字符串，大字符;
** 						显示的位置(x, y)，x为行范围0~15，y为页范围0~3，要显示的字符;
**					    
** 输入变量:			u8 x, u8 y, char ch;
** 返回值:				void;
**
** 使用宏或常量:		None;
** 使用全局变量:		None;
**
** 调用函数:			None;
**
** 创建人:				
** 创建日期:			2011-11-1
**-------------------------------------------------------------------------------------------------------------
** 修订人:
** 修订日期:
**-------------------------------------------------------------------------------------------------------------
***************************************************************************************************************/
void OLED_P8x16Char(u8 x, u8 y, char ch)
{
	u8 c = 0, i = 0;
    
    if (x > 120 || y > 7)                       // 120=128-8，最右边一个字符显示起始坐标
        return;

    x <<= 3;
    
    if (ch >= 32 && ch <= 125)
    {
        c = ch - 32;
        
    //  OLED_Set_Pos(x, y);                     // 上半部分
        OLED_WrCmd(0xb0 + (y << 1));
        OLED_WrCmd(((x & 0xf0) >> 4) | 0x10);
        OLED_WrCmd((x & 0x0f) | 0x01);
        for (i = 0; i < 8; i++)
        {
            OLED_WrDat(F8X16[(c << 4) + i]);
        }
        
    //  OLED_Set_Pos(x, y+1);                   // 下半部分
        OLED_WrCmd(0xb1 + (y << 1));
        OLED_WrCmd(((x & 0xf0) >> 4) | 0x10);
        OLED_WrCmd((x & 0x0f) | 0x01);
        for (i = 0; i < 8; i++)
        {
            OLED_WrDat(F8X16[(c << 4) + i + 8]);
        }
    }
}


/*************************************************************************************************************
** 函数名称:			OLED_P8x16Str
**
** 函数描述:			写入一组标准ASCII字符串，大字符串;
** 						显示的位置(x, y)，x为行范围0~120，y为页范围0~7，要显示的字符串;
**					    
** 输入变量:			u8 x, u8 y, u8 ch[];
** 返回值:				void;
**
** 使用宏或常量:		None;
** 使用全局变量:		None;
**
** 调用函数:			None;
**
** 创建人:				
** 创建日期:			2011-11-1
**-------------------------------------------------------------------------------------------------------------
** 修订人:
** 修订日期:
**-------------------------------------------------------------------------------------------------------------
***************************************************************************************************************/
void OLED_P8x16Str(u8 x, u8 y, char ch[])
{
	u8 c = 0, i = 0, j = 0;
    
    if (x > 16 || y > 4)                       // 120=128-8，最右边一个字符显示起始坐标
        return;
    
    x <<= 3;
    
	while (ch[j] != '\0')
	{   
		c = ch[j] - 32;
		if (x > 120)
        {
            x = 0;
            y++;
            
            if (y > 4)
                return;
        }
        
	//	OLED_Set_Pos(x, y);
        OLED_WrCmd(0xb0 + (y << 1));
        OLED_WrCmd(((x & 0xf0) >> 4) | 0x10);
        OLED_WrCmd((x & 0x0f) | 0x01);
		for (i = 0; i < 8; i++)
        {
            OLED_WrDat(F8X16[(c << 4) + i]);
        }
        
	//	OLED_Set_Pos(x, y+1);
        OLED_WrCmd(0xb1 + (y << 1));
        OLED_WrCmd(((x & 0xf0) >> 4) | 0x10);
        OLED_WrCmd((x & 0x0f) | 0x01);
		for (i = 0; i < 8; i++)
        {
            OLED_WrDat(F8X16[(c << 4) + i + 8]);
        }
        
		x += 8;
		j++;
	}
}

void OLED_String(unsigned char X, unsigned char Y, char String[])
{
	OLED_P8x16Str(X, Y, String);
}


/*************************************************************************************************************
** 函数名称:			OLED_P6x8Num_8bit
**
** 函数描述:			显示小数字;
** 						
**					    
** 输入变量:			unsigned char x, unsigned char y, unsigned char Number;
** 返回值:				void;
**
** 使用宏或常量:		None;
** 使用全局变量:		None;
**
** 调用函数:			None;
**
** 创建人:				
** 创建日期:			2011-11-1
**-------------------------------------------------------------------------------------------------------------
** 修订人:
** 修订日期:
**-------------------------------------------------------------------------------------------------------------
***************************************************************************************************************/
void OLED_Dis6x8CharNum(unsigned char x, unsigned char y, unsigned char Number)
{
/*	unsigned char ch[3] = {0};              // 原程序，显示001
	int n = 0;
    
	for(n = 2; n >= 0; n--)
	{
		ch[n] = Number % 10 + '0';
		Number = Number / 10;
	}
    
	OLED_P6x8Str(x, y, ch);
*/  
/*  char ch[1] = {0};                       // 只显示1位，吴康修改
    
	ch[0] = Number % 10 + '0';
//	Number = Number / 10;
    
	OLED_P6x8Str(x, y, ch);
*/    
    char ch = 0;                            // 只显示1位，吴康修改
    
	ch = Number % 10 + '0';
    
	OLED_P6x8Char(x, y, ch);
}


/*************************************************************************************************************
** 函数名称:			OLED_P8x16Num_8bit
**
** 函数描述:			显示大数字;
** 						
**					    
** 输入变量:			unsigned char x, unsigned char y, unsigned char Number;
** 返回值:				void;
**
** 使用宏或常量:		None;
** 使用全局变量:		None;
**
** 调用函数:			None;
**
** 创建人:				
** 创建日期:			2011-11-1
**-------------------------------------------------------------------------------------------------------------
** 修订人:
** 修订日期:
**-------------------------------------------------------------------------------------------------------------
***************************************************************************************************************/
void OLED_Dis8x16CharNum(unsigned char x, unsigned char y, unsigned char Number)
{
/*	unsigned char ch[3] = {0};          // 原程序，显示001
	int n = 0;
    
	for(n = 2; n >= 0; n--)
	{
		ch[n] = Number % 10 + '0';
		Number = Number / 10;
	}
    
	OLED_P8x16Str(x, y, ch);
*/
/*  char ch[1] = {0};                   // 只显示1位，吴康修改
    
	ch[0] = Number % 10 + '0';
//	Number = Number / 10;
    
	OLED_P8x16Str(x, y, ch);
*/    
    char ch = 0;                        // 只显示1位，吴康修改
    
	ch = Number % 10 + '0';
    
	OLED_P8x16Char(x, y, ch);
}


/*************************************************************************************************************
** 函数名称:			Wp_DisP16x16DotArray
**
** 函数描述:			显示16*16点阵汉字;
** 						x行范围0~7，y页范围0~3，n为点阵数组字体顺序;
**					    
** 输入变量:			unsigned char x, unsigned char y, unsigned char n;
** 返回值:				void;
**
** 使用宏或常量:		None;
** 使用全局变量:		None;
**
** 调用函数:			None;
**
** 创建人:				
** 创建日期:			2011-11-1
**-------------------------------------------------------------------------------------------------------------
** 修订人:
** 修订日期:
**-------------------------------------------------------------------------------------------------------------
***************************************************************************************************************/
void Wp_DisP16x16DotArray(unsigned char x, unsigned char y, unsigned char n)
{
	unsigned char i = 0;
	unsigned int adder = 32 * n;
    
    x <<= 4;
    
//	OLED_Set_Pos(x, y);
    OLED_WrCmd(0xb0 + (y << 1));
    OLED_WrCmd(((x & 0xf0) >> 4) | 0x10);
    OLED_WrCmd((x & 0x0f) | 0x01);
    
	for(i = 0; i < 16; i++)
	{
		OLED_WrDat(Atti16x16[adder]);
		adder += 1;
	}
    
//	OLED_Set_Pos(x, y+1);
    OLED_WrCmd(0xb1 + (y << 1));
    OLED_WrCmd(((x & 0xf0) >> 4) | 0x10);
    OLED_WrCmd((x & 0x0f) | 0x01);    
    
	for(i = 0; i < 16; i++)
	{
		OLED_WrDat(Atti16x16[adder]);
		adder += 1;
	}
}


/*************************************************************************************************************
** 函数名称:			Wp_DisP16x16HanZiArray
**
** 函数描述:			显示16*16点阵汉字;
** 						
**					    
** 输入变量:			unsigned char x, unsigned char y, const unsigned char hanzi[], unsigned char n;
** 返回值:				void;
**
** 使用宏或常量:		None;
** 使用全局变量:		None;
**
** 调用函数:			None;
**
** 创建人:				
** 创建日期:			2011-11-1
**-------------------------------------------------------------------------------------------------------------
** 修订人:
** 修订日期:
**-------------------------------------------------------------------------------------------------------------
***************************************************************************************************************/
void Wp_DisP16x16HanZiArray(unsigned char x, unsigned char y, const unsigned char hanzi[], unsigned char n)
{
	unsigned char i = 0;
	unsigned int adder = 32 * n;
    
    x <<= 4;
    
//	OLED_Set_Pos(x, y);
    OLED_WrCmd(0xb0 + (y << 1));
    OLED_WrCmd(((x & 0xf0) >> 4) | 0x10);
    OLED_WrCmd((x & 0x0f) | 0x01);
    
	for(i = 0; i < 16; i++)
	{
		OLED_WrDat(hanzi[adder]);
		adder += 1;
	}
    
//	OLED_Set_Pos(x, y+1);
    OLED_WrCmd(0xb1 + (y << 1));
    OLED_WrCmd(((x & 0xf0) >> 4) | 0x10);
    OLED_WrCmd((x & 0x0f) | 0x01);    
    
	for(i = 0; i < 16; i++)
	{
		OLED_WrDat(hanzi[adder]);
		adder += 1;
	}
}


/*************************************************************************************************************
** 函数名称:			Wp_DisIntNum
**
** 函数描述:			固定位置显示数字;
** 						显示的位置(x, y)，x为行范围0~15，y为页范围0~7，num为显示数字，n为显示位数，最多显示5位;
**					    
** 输入变量:			unsigned char x, unsigned char y, unsigned int num, unsigned char n;
** 返回值:				void;
**
** 使用宏或常量:		None;
** 使用全局变量:		None;
**
** 调用函数:			None;
**
** 创建人:				
** 创建日期:			2011-11-1
**-------------------------------------------------------------------------------------------------------------
** 修订人:
** 修订日期:
**-------------------------------------------------------------------------------------------------------------
***************************************************************************************************************/
static u8 int_minus;
void Wp_DisIntNum(unsigned char x, unsigned char y, int num, unsigned char n) 
{
	unsigned char i = 0;
	char ch[5] = {0};

  unsigned int real_num;
	if(num < 0)
	{
		real_num = -num;
		int_minus = 1;
	}
	else
	{
		real_num = num;
		int_minus = 0;
	}
//	x = x * 8;
    
	ch[0] = (real_num / 10000) % 10;                  // 万
	ch[1] = (real_num / 1000) % 10;                   // 千
	ch[2] = (real_num / 100) % 10;                    // 百
	ch[3] = (real_num / 10) % 10;                     // 十
	ch[4] = real_num % 10;                            // 个
    
	for (i = 0; i < 5; i++)
    {
     // ch[i] = ch[i] + 16 + 32;
        ch[i] += 48;
    }
		
	if(int_minus == 1)
    ch[5-n] = '-';
	
	OLED_P8x16Str(x, y, &ch[5-n]);				// 从ACSII码表中读取字节，然后写入OLED
}

void OLED_Int(unsigned char X, unsigned char Y, int Value, unsigned char Lenght)
{
	Wp_DisIntNum(X, Y, Value, Lenght);
}

/*************************************************************************************************************
** 函数名称:			Wp_DisfloatIntegeranddecimal
**
** 函数描述:			固定位置显示数字;
** 						显示的位置(x, y)，x为行范围0~15，y为页范围0~7，real为显示的浮点数，N显示的小数位;
**					    
** 输入变量:			unsigned char x, unsigned char y, unsigned int num, unsigned char N;
** 返回值:				void;
**
** 使用宏或常量:		None;
** 使用全局变量:		None;
**
** 调用函数:			None;
**
** 创建人:				
** 创建日期:			2011-11-1
**-------------------------------------------------------------------------------------------------------------
** 修订人:
** 修订日期:
**-------------------------------------------------------------------------------------------------------------
***************************************************************************************************************/
void Wp_Disfloat(unsigned char x, unsigned char y, float real, unsigned char n)
{
//	unsigned char i_Count = 1;
	char ch[9] = {0};
	u16 j = 1;
	unsigned int real_int = 0;              // 整数部分缓存
	double decimal = 0;
	unsigned int real_decimal = 0;          // 小数部分缓存
    
//	x = x * 8;                              // X轴其实位
	real_int = (int)real;                   // 整数部分
	decimal = real - real_int;
	real_decimal = decimal * 1e4;           // 小数部分，放大1000倍
    
/*	while(real_int/10/j != 0)               // 计算整数部分位数
	{
        j = j * 10;
        i_Count++;
	}
*/  
	ch[0] = (real_int / 10000) % 10; 
	ch[1] = (real_int / 1000) % 10;
	ch[2] = (real_int / 100) % 10;
	ch[3] = (real_int / 10) % 10;
	ch[4] = (real_int / 1) % 10;
    
	ch[6] = (real_decimal / 1000) % 10;
	ch[7] = (real_decimal / 100) % 10;
//	ch[8] = (real_decimal / 10) % 10;
//	ch[9] = real_decimal % 10;
    
	for(j = 0; j < 9; j++) 
    {
        ch[j] = ch[j] + 16 + 32;
    }
    
	ch[5] = '.';
	ch[6 + n] = '\0';                        // 结束标志
    
	OLED_P8x16Str(x, y, &ch[2]);             // 自动计算整数部分位数，这里直接显示3位整数部分
}


/*************************************************************************************************************
** 函数名称:			Wp_DisfloatIntegerandDecimal
**
** 函数描述:			固定位置显示数字;
** 						显示的位置(x, y)，x为行范围0~15，y为页范围0~7，real为显示的浮点数，N1为显示整数位，N2为显示的小数位;
**					    
** 输入变量:			unsigned char x, unsigned char y, unsigned int num, unsigned char N;
** 返回值:				void;
**
** 使用宏或常量:		None;
** 使用全局变量:		None;
**
** 调用函数:			None;
**
** 创建人:				
** 创建日期:			2011-11-1
**-------------------------------------------------------------------------------------------------------------
** 修订人:
** 修订日期:
**-------------------------------------------------------------------------------------------------------------
***************************************************************************************************************/

static u32 mul;
static u16 i;
static u16 index;
static u8 minus;
void Wp_DisfloatIntegerandDecimal(unsigned char x, unsigned char y, float real, unsigned char N1, unsigned char N2) 
{
//	unsigned char i_Count = 1;
	char n[20] = {0};
	u16 j = 1;
    
	unsigned int real_int = 0;          // 整数部分缓存
	float decimal = 0;
	unsigned int real_decimal = 0;      // 小数部分缓存

	if(real < 0)
	{
		real = -real;
		minus = 1;
	}
	else
	{
		minus = 0;
	}
    
//	x = x * 8;                          // X轴起始位
    
	real_int = (int)real;               // 整数部分
	decimal = real - real_int;
	if(N2 > 7)
		N2 = 7;
	mul = 10;
	for(i=0;i<N2;i++)
	{
		mul *= 10;
	}
	real_decimal = decimal * mul;       // 小数部分，放大1000倍
    
/*	while(real_int/10/j != 0)           // 计算整数部分位数
	{
        j = j * 10;
        i_Count++;
	}
*/  
	n[0] = (real_int / 10000) % 10; 
	n[1] = (real_int / 1000) % 10;
	n[2] = (real_int / 100) % 10;
	n[3] = (real_int / 10) % 10;
	n[4] = (real_int / 1) % 10;
  
	index = 5;
	while (index < 16 && mul > 1)
	{
		n[index] = (real_decimal / mul) % 10;
		index ++;
		mul /= 10;
	}
	for(j = 0; j < 16; j++) 
	{
			n[j] = n[j] + 16 + 32;
	}
    
	n[5] = '.';
	
	n[index] = '\0';                     // 结束标志
	
	if(minus > 0)
		n[5-N1] = '-';
	
	OLED_P8x16Str(x ,y, &n[5-N1]);        // (5-N1)决定开始标志
}

void OLED_Float(unsigned char X, unsigned char Y, float Value, unsigned char IntPart, unsigned char FraPart)
{
	Wp_DisfloatIntegerandDecimal(X, Y, Value, IntPart, FraPart);
}


/*************************************************************************************************************
** 函数名称:			fputc
**
** 函数描述:			定义 fputc 此函数为printf所用;
** 						
**					    
** 输入变量:			int ch;
** 返回值:				int;
**
** 使用宏或常量:		None;
** 使用全局变量:		None;
**
** 调用函数:			None;
**
** 创建人:				
** 创建日期:			2011-11-1
**-------------------------------------------------------------------------------------------------------------
** 修订人:
** 修订日期:
**-------------------------------------------------------------------------------------------------------------
***************************************************************************************************************/
int fputc(int ch)
{
	static u8 s_bClearScreen = 0;
    
	if (s_bClearScreen)
	{
		s_bClearScreen = 0;
		Wp_ClearOled();
	}
	if (ch == '\n')                     // 换行，光标移动下一行的首行
	{
	//	oled_y++;
		oled_x = 0;
	}
    if (oled_x > 15)
	{	
		oled_y++;
		oled_x = 0;
	}
	if (oled_y > 4)
	{
		s_bClearScreen = 1;
	}
	if (ch != '\r' && ch != '\n')       // '\r'回车，光标移到当前行的首行
	{
		OLED_P8x16Char(oled_x, oled_y, (u8)ch);
	//	oled_x += 8;
        oled_x += 1;
	}
    
    return ch; 
}


/********************************************************************************************************
**                            End Of File
********************************************************************************************************/
